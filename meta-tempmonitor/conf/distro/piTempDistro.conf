## meta-tempmonitor/conf/distro/piTempDistro.conf
```bitbake
require conf/distro/poky.conf

DISTRO = "piTempDistro"
DISTRO_NAME = "piTempDistro"
DISTRO_VERSION = "0.1"

DISTRO_FEATURES:append = " wifi"

DISTRO_FEATURES:append = " systemd"
DISTRO_FEATURES_BACKFILL_CONSIDERED += "sysvinit"
VIRTUAL-RUNTIME_init_manager = "systemd"
VIRTUAL-RUNTIME_initscripts = "systemd-compat-units"
```

## meta-tempmonitor/conf/layer.conf
```bitbake
# We have a conf and classes directory, add to BBPATH
BBPATH .= ":${LAYERDIR}"

# We have recipes-* directories, add to BBFILES
BBFILES += "${LAYERDIR}/recipes-*/*/*.bb \
            ${LAYERDIR}/recipes-*/*/*.bbappend"

BBFILE_COLLECTIONS += "tempmonitor"
BBFILE_PATTERN_tempmonitor = "^${LAYERDIR}/"
BBFILE_PRIORITY_tempmonitor = "6"

LAYERDEPENDS_tempmonitor = "core"

LAYERSERIES_COMPAT_tempmonitor = "honister"
```

## meta-tempmonitor/conf/machine/piTemp.conf
```bitbake
inherit raspberrypi3

DISTRO = "piTempDistro"
DISTRO_FEATURES:append = " wifi"

DISTRO_FEATURES:append = " systemd"
DISTRO_FEATURES_BACKFILL_CONSIDERED += "sysvinit"
VIRTUAL-RUNTIME_init_manager = "systemd"
VIRTUAL-RUNTIME_initscripts = "systemd-compat-units"
IMAGE_INSTALL:append = " tempmonitor"
```
